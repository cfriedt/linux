## drivers/crypto/al/Kconfig
```kconfig
config CRYPTO_DEV_AL_CRYPTO
	tristate "Support for Annapurna Labs Crypto engine"
	depends on ARCH_ALPINE
	select CRYPTO_AES
	select CRYPTO_DES
	select CRYPTO_SHA256
	select CRYPTO_ALGAPI
	select CRYPTO_AUTHENC
	select CRYPTO_BLKCIPHER
	select CRYPTO_CRC32C
	select CRYPTO_DEV_AL_RMN_2871
	help
	  Enable support for the Annapurna Labs Crypto acceleration engine.
	  Currently AES and SHA256 are supported.

config CRYPTO_DEV_AL_CRYPTO_STATS
	bool "Annapurna Labs Crypto statistics enabled"
	depends on CRYPTO_DEV_AL_CRYPTO
	help
	  Enable Annapurna Labs Crypto acceleration engine statistics.

config CRYPTO_DEV_AL_AHASH_CRC
	def_bool CRYPTO_DEV_AL_CRYPTO

config CRYPTO_DEV_AL_RMN_2871
	bool "Annapurna Labs MSI-X and legacy interrupts RMN 2871 fix"
	depends on CRYPTO_DEV_AL_CRYPTO
	help
	  Enable Annapurna Labs RMN 2871 fix.
```

## drivers/pinctrl/fake/Kconfig
```kconfig
#
# Fake pin control drivers
#

config PINCTRL_FAKE
	tristate "Fake pin control device"
	select PINMUX
	select GENERIC_PINCONF
	help
	  Pin control driver for muxing various fake devices and busses on any
	  system. Based on example described in Documentation/pinctrl.txt.
	  
	  To compile this code as a module, choose M here: the
	  module will be called pinctrl-fake.

config I2C_FAKE
	boolean "Fake I2C bus"
	depends on PINCTRL_FAKE && I2C
	help
	  Pin control driver for a fake i2c bus. Based on example described in
	  Documentation/pinctrl.txt.

config I2C_FAKE_AT24
	boolean "Fake AT24C32 I2C EEPROM"
	depends on I2C_FAKE
	help
	  A simulated eeprom device for the fake i2c bus.

config I2C_FAKE_MCP9808
	boolean "Fake MCP9808 Temperature Sensor"
	depends on I2C_FAKE
	help
	  A simulated temperature sensor for the fake i2c bus.

config I2C_FAKE_MCP9808_WORKER
	boolean "Simulated input for the fake MCP9808"
	depends on I2C_FAKE_MCP9808
	help
	  This option creates scheduled work that simulates a monotonically
	  increasing temperature. The temperature wraps back to the lower
	  bound when it reaches the upper bound.
	  
	  Updates occur periodically. The default period will be 1000 ms.

config SPI_FAKE
	boolean "Fake SPI bus"
	depends on PINCTRL_FAKE && SPI
	help
	  Pin control driver for a fake i2c bus. Based on example described in
	  Documentation/pinctrl.txt.

config SPI_FAKE_AT25
	boolean "Fake AT25 SPI EEPROM"
	depends on SPI_FAKE
	help
	  A simulated eeprom device for the fake spi bus.

config SPI_FAKE_MAX6662
	boolean "Fake MAX6662 Temperature Sensor"
	depends on SPI_FAKE
	help
	  A simulated temperature sensor for the fake spi bus.

config SPI_FAKE_MAX6662_WORKER
	boolean "Simulated input for the fake MAX6662"
	depends on SPI_FAKE_MAX6662
	help
	  This option creates scheduled work that simulates a monotonically
	  increasing temperature. The temperature wraps back to the lower
	  bound when it reaches the upper bound.
	  
	  Updates occur periodically. The default period will be 1000 ms.

	  
```
